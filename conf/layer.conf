## conf/layer.conf
```bitbake
# We have a conf and classes directory, add to BBPATH
BBPATH .=":${LAYERDIR}"

# We have a recipes-* directories, add to BBFILES
BBFILES += "${LAYERDIR}/recipes-*/*/*.bb \
            ${LAYERDIR}/recipes-*/*/*.bbappend"

BBFILE_COLLECTIONS += "tt3201"
BBFILE_PATTERN_tt3201 = "^${LAYERDIR}/"
BBFILE_PRIORITY_tt3201 = "5"
```
